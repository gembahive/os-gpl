## linux/edge/arm64.defconfig
```kconfig
CONFIG_NO_HZ_IDLE=y
CONFIG_BPF_SYSCALL=y
CONFIG_CGROUPS=y
CONFIG_CGROUP_PIDS=y
CONFIG_CGROUP_BPF=y
CONFIG_BLK_DEV_INITRD=y
CONFIG_INITRAMFS_SOURCE="initramfs"
CONFIG_ARCH_AXERA=y
CONFIG_ARM64_VA_BITS_39=y
CONFIG_NR_CPUS=2
CONFIG_HZ_100=y
CONFIG_ARM64_SW_TTBR0_PAN=y
CONFIG_RANDOMIZE_BASE=y
# CONFIG_EFI is not set
# CONFIG_SUSPEND is not set
CONFIG_PM=y
CONFIG_PARTITION_ADVANCED=y
# CONFIG_EFI_PARTITION is not set
CONFIG_CMA=y
CONFIG_NET=y
CONFIG_PACKET=y
CONFIG_UNIX=y
CONFIG_INET=y
CONFIG_CFG80211=y
CONFIG_RFKILL=y
CONFIG_DEVTMPFS=y
CONFIG_DEVTMPFS_MOUNT=y
CONFIG_EXTRA_FIRMWARE="ax620e-ce.bin sitronix,st7789p3.bin fmacfw_8800d80_h_u02.bin fw_adid_8800d80_u02.bin fw_patch_8800d80_u02.bin fw_patch_8800d80_u02_ext0.bin fw_patch_table_8800d80_u02.bin aic_userconfig_8800d80.txt regulatory.db regulatory.db.p7s"
CONFIG_EXTRA_FIRMWARE_DIR="firmware"
CONFIG_AX620E_CHIPKEY=y
CONFIG_LT7911_MANAGE=y
CONFIG_MD=y
CONFIG_BLK_DEV_DM=y
CONFIG_DM_CRYPT=y
CONFIG_DM_VERITY=y
CONFIG_NETDEVICES=y
CONFIG_AIC8800=y
CONFIG_INPUT_EVDEV=y
CONFIG_INPUT_TOUCHSCREEN=y
CONFIG_TOUCHSCREEN_HYNITRON_CST816X=y
# CONFIG_LEGACY_PTYS is not set
CONFIG_SERIAL_8250=y
CONFIG_SERIAL_8250_DW=y
CONFIG_NULL_TTY=y
# CONFIG_DEVMEM is not set
# CONFIG_DEVPORT is not set
CONFIG_I2C_DESIGNWARE_CORE=y
CONFIG_SPI=y
CONFIG_SPI_DESIGNWARE=y
CONFIG_SPI_DW_MMIO=y
CONFIG_PINCTRL=y
CONFIG_GPIOLIB=y
CONFIG_THERMAL=y
CONFIG_AX620E_THERMAL=y
CONFIG_WATCHDOG=y
CONFIG_WATCHDOG_NOWAYOUT=y
CONFIG_WATCHDOG_SYSFS=y
CONFIG_AX620E_WATCHDOG=y
CONFIG_MEDIA_SUPPORT=y
# CONFIG_MEDIA_SUBDRV_AUTOSELECT is not set
CONFIG_MEDIA_PLATFORM_SUPPORT=y
CONFIG_V4L_PLATFORM_DRIVERS=y
CONFIG_V4L_MEM2MEM_DRIVERS=y
CONFIG_VIDEO_AX620E_VIN=y
CONFIG_VIDEO_AX620E_TDP=y
CONFIG_VIDEO_AX620E_JPEG=y
CONFIG_DRM=y
CONFIG_DRM_FBDEV_EMULATION=y
CONFIG_DRM_PANEL_MIPI_DBI=y
CONFIG_FB_DEVICE=y
CONFIG_BACKLIGHT_PWM=y
# CONFIG_FRAMEBUFFER_CONSOLE is not set
CONFIG_DRM_ACCEL=y
CONFIG_DRM_ACCEL_AX620E_NPU=y
CONFIG_USB_DWC3=y
# CONFIG_USB_DWC3_OF_SIMPLE is not set
# CONFIG_USB_DWC3_GENERIC_PLAT is not set
CONFIG_USB_GADGET=y
CONFIG_USB_CONFIGFS=y
CONFIG_USB_CONFIGFS_ACM=y
CONFIG_USB_CONFIGFS_F_FS=y
CONFIG_MMC=y
CONFIG_MMC_SDHCI=y
CONFIG_MMC_SDHCI_PLTFM=y
CONFIG_MMC_SDHCI_CADENCE=y
CONFIG_PWM=y
CONFIG_PWM_DWC_OF=y
CONFIG_TEE=y
CONFIG_OPTEE=y
CONFIG_EXT4_FS=y
CONFIG_AUTOFS_FS=y
CONFIG_VFAT_FS=y
CONFIG_TMPFS=y
CONFIG_TMPFS_POSIX_ACL=y
CONFIG_PSTORE=y
CONFIG_PSTORE_CONSOLE=y
CONFIG_PSTORE_RAM=y
CONFIG_NLS_CODEPAGE_437=y
CONFIG_NLS_ISO8859_1=y
CONFIG_SECURITY_DMESG_RESTRICT=y
CONFIG_SECURITY=y
CONFIG_SECURITYFS=y
CONFIG_SECURITY_LOADPIN=y
CONFIG_SECURITY_LOADPIN_ENFORCE=y
CONFIG_SECURITY_LOADPIN_VERITY=y
CONFIG_SECURITY_YAMA=y
CONFIG_SECURITY_LOCKDOWN_LSM=y
CONFIG_LOCK_DOWN_KERNEL_FORCE_INTEGRITY=y
CONFIG_CRYPTO_XTS=y
CONFIG_CRYPTO_AES_ARM64_BS=y
CONFIG_DMA_CMA=y
CONFIG_CMA_SIZE_PERCENTAGE=50
CONFIG_CMA_SIZE_SEL_PERCENTAGE=y
CONFIG_PRINTK_TIME=y
CONFIG_DEBUG_KERNEL=y
CONFIG_MAGIC_SYSRQ=y
CONFIG_MAGIC_SYSRQ_DEFAULT_ENABLE=0x0
# CONFIG_MAGIC_SYSRQ_SERIAL is not set
CONFIG_PANIC_ON_OOPS=y
CONFIG_PANIC_TIMEOUT=5
CONFIG_HARDLOCKUP_DETECTOR=y
CONFIG_BOOTPARAM_HARDLOCKUP_PANIC=y
```

## linux/tree/drivers/accel/ax620e-npu/Kconfig
```kconfig
# SPDX-License-Identifier: GPL-2.0-only

config DRM_ACCEL_AX620E_NPU
	tristate "Axera AX620E NPU"
	depends on DRM_ACCEL && OF
	depends on ARCH_AXERA || COMPILE_TEST
	select DRM_GEM_DMA_HELPER
	help
	  The AX620E family's neural network processor as one accel device,
	  run as a single NPU with all of its on-chip memory. Models load
	  only from /lib/firmware/npu/; the kernel builds every command list.
```

## linux/tree/drivers/media/platform/axera/Kconfig
```kconfig
# SPDX-License-Identifier: GPL-2.0-only

config VIDEO_AX620E_VIN
	tristate "Axera AX620E video capture (CSI-2 receiver + VIN)"
	depends on V4L_PLATFORM_DRIVERS && VIDEO_DEV=y && OF
	depends on ARCH_AXERA || COMPILE_TEST
	select V4L2_FWNODE
	select VIDEOBUF2_DMA_CONTIG
	select MFD_SYSCON
	help
	  The MIPI CSI-2 receiver and the VIN's ISP-bypass path of the Axera
	  AX620E family: whole packed YUV 4:2:2 frames from a CSI-2 bridge to
	  memory, as one V4L2 capture node.

config VIDEO_AX620E_TDP
	tristate "Axera AX620E TDP scaler"
	depends on V4L_MEM2MEM_DRIVERS && VIDEO_DEV=y && OF && HAS_DMA
	depends on ARCH_AXERA || COMPILE_TEST
	select VIDEOBUF2_DMA_CONTIG
	select V4L2_MEM2MEM_DEV
	help
	  The two-dimensional processor of the Axera AX620E family: crop,
	  scale and colour conversion of NV12/YUYV frames to NV12 or RGB565,
	  as one V4L2 mem2mem node.

config VIDEO_AX620E_JPEG
	tristate "Axera AX620E JPEG encoder"
	depends on V4L_MEM2MEM_DRIVERS && VIDEO_DEV=y && OF && HAS_DMA
	depends on ARCH_AXERA || COMPILE_TEST
	select VIDEOBUF2_DMA_CONTIG
	select V4L2_MEM2MEM_DEV
	select V4L2_JPEG_HELPER
	help
	  The VeriSilicon JPEG encoder of the Axera AX620E family, driven
	  through its VCMD command engine: raw frames in, baseline JPEG out,
	  as one V4L2 mem2mem node.
```

## linux/tree/drivers/net/wireless/aic8800/Kconfig
```kconfig
# SPDX-License-Identifier: GPL-2.0
config AIC8800
	bool "AICSemi AIC8800 SDIO Wi-Fi"
	depends on CFG80211 && MMC
	help
	  The AICSemi AIC8800 family over SDIO, Wi-Fi only: aic8800_bsp (SDIO
	  transport, chip bring-up, firmware download) and aic8800_fdrv (the
	  FullMAC cfg80211 driver). The firmware it requests must be built in
	  (EXTRA_FIRMWARE): it runs before the root filesystem is mounted.
```

## u-boot/tree/arch/arm/mach-axera/Kconfig
```kconfig
if ARCH_AXERA

config SYS_VENDOR
	default "axera"

config SYS_BOARD
	default "ax620e"

config SYS_CONFIG_NAME
	default "ax620e"

choice
	prompt "Board"

config TARGET_AX620E_EDGE
	bool "Edge (AX620Q, boots from its TF card)"
	select CPU_V7A

config TARGET_AX620E_EDGE64
	bool "Edge, AArch64 BL33"
	select ARM64
	select LINUX_KERNEL_IMAGE_HEADER
	help
	  The Edge's U-Boot as TF-A's BL33 (Non-secure EL2, under BL31).
	  The arm64 Image header makes u-boot.bin loadable from a FIT as a
	  "linux" image.

endchoice

# text_offset 0: the header names the extent from wherever it is loaded (POSITION_INDEPENDENT).
config LNX_KRNL_IMG_TEXT_OFFSET_BASE
	depends on LINUX_KERNEL_IMAGE_HEADER
	default TEXT_BASE

config AX620E_SLOTS_WITHOUT_HANDOFF
	bool "Boot the A/B slots with no SPL64 handoff block"
	depends on ARM64
	help
	  Without SPL64's handoff block the eFuse rollback floor is unknown
	  (U-Boot64 is Non-secure and never reads the eFuses), so slots booted
	  then would bypass rollback protection: a release loader refuses
	  them (the stash and recovery on the pin still boot). With this on,
	  slots boot with reset reason 0 and floor 0.

config AX620E_CE_RNG
	bool "Random numbers from the security engine"
	depends on TARGET_AX620E_EDGE64 && DM_RNG
	default y
	help
	  The EIP-130's random numbers as an RNG device, so bootm hands
	  Linux /chosen/kaslr-seed and rng-seed. The engine's signed
	  firmware (arch/arm/mach-axera/ce-fw.bin, supplied by the build)
	  is built in and loaded unless an earlier stage already did.

config AX620E_VERBOSE_BOOT
	bool "The console on the front panel, over the logo"
	depends on TARGET_AX620E_EDGE64 && DM_SPI && DESIGNWARE_SPI && VIDEO
	depends on CONSOLE_MUX && SYS_CONSOLE_IS_IN_ENV
	select VIDEO_DAMAGE
	help
	  The panel as a video device: what U-Boot prints after console
	  init, drawn over the boot logo as it is printed. Needs stdout
	  and stderr to name "vidconsole" in the default environment.

config AX620E_SERIAL_CONSOLE
	bool "The board's UART as U-Boot's and Linux's console"
	depends on DM_SERIAL
	select SYS_NS16550
	help
	  Without it no UART driver is built, so U-Boot neither reads nor
	  writes the UART, and Linux boots with console=ttynull.

config AX620E_LINUX_CONSOLE
	string "Linux's console= (the board's UART)"
	depends on AX620E_SERIAL_CONSOLE

config AX620E_LINUX_EARLYCON
	string "Linux's earlycon= (the same UART)"
	depends on AX620E_SERIAL_CONSOLE

endif
```

## u-boot/tree/configs/ax620e_edge64_defconfig
```kconfig
CONFIG_ARM=y
CONFIG_POSITION_INDEPENDENT=y
# CONFIG_ARM64_SUPPORT_AARCH32 is not set
CONFIG_ARCH_AXERA=y
CONFIG_TEXT_BASE=0x44000000
CONFIG_TARGET_AX620E_EDGE64=y
CONFIG_NR_DRAM_BANKS=1
CONFIG_ENV_SIZE=0x10000
CONFIG_ENV_OFFSET=0x8400000
CONFIG_DEFAULT_DEVICE_TREE="ax620e-edge"
CONFIG_SYS_BOOTM_LEN=0x4000000
CONFIG_SYS_LOAD_ADDR=0x46000000
CONFIG_ENV_OFFSET_REDUND=0x8800000
# CONFIG_PSCI_RESET is not set
# CONFIG_EFI_LOADER is not set
CONFIG_FIT=y
CONFIG_FIT_SIGNATURE=y
# CONFIG_BOOTSTD is not set
CONFIG_BOOTDELAY=-2
CONFIG_OF_BOARD_SETUP=y
CONFIG_USE_BOOTCOMMAND=y
CONFIG_BOOTCOMMAND="abboot"
# CONFIG_DISPLAY_CPUINFO is not set
CONFIG_BOARD_LATE_INIT=y
CONFIG_BOARD_RNG_SEED=y
# CONFIG_CMD_BDI is not set
# CONFIG_CMD_CONSOLE is not set
# CONFIG_CMD_BOOTD is not set
# CONFIG_BOOTM_PLAN9 is not set
# CONFIG_BOOTM_RTEMS is not set
# CONFIG_BOOTM_VXWORKS is not set
# CONFIG_CMD_ELF is not set
# CONFIG_CMD_FDT is not set
# CONFIG_CMD_GO is not set
# CONFIG_CMD_RUN is not set
# CONFIG_CMD_IMI is not set
# CONFIG_CMD_XIMG is not set
# CONFIG_CMD_EXPORTENV is not set
# CONFIG_CMD_IMPORTENV is not set
# CONFIG_CMD_EDITENV is not set
# CONFIG_CMD_ENV_EXISTS is not set
# CONFIG_CMD_CRC32 is not set
# CONFIG_CMD_MEMORY is not set
# CONFIG_CMD_LZMADEC is not set
# CONFIG_CMD_UNLZ4 is not set
# CONFIG_CMD_UNZIP is not set
# CONFIG_CMD_LOADB is not set
# CONFIG_CMD_LOADS is not set
# CONFIG_CMD_ECHO is not set
# CONFIG_CMD_ITEST is not set
# CONFIG_CMD_SOURCE is not set
# CONFIG_CMD_SETEXPR is not set
# CONFIG_CMD_BLOCK_CACHE is not set
# CONFIG_CMD_SLEEP is not set
CONFIG_DOS_PARTITION=y
CONFIG_DEVICE_TREE_INCLUDES="ax620e-edge-key.dtsi"
CONFIG_ENV_IS_IN_MMC=y
CONFIG_ENV_REDUNDANT=y
CONFIG_ENV_MMC_DEVICE_INDEX=1
CONFIG_ENV_WRITEABLE_LIST=y
CONFIG_NO_NET=y
CONFIG_MMC_SDHCI=y
CONFIG_MMC_SDHCI_SDMA=y
CONFIG_MMC_SDHCI_CADENCE=y
CONFIG_DM_RNG=y
# CONFIG_REQUIRE_SERIAL_CONSOLE is not set
CONFIG_DM_SERIAL=y
CONFIG_SPI=y
CONFIG_DM_SPI=y
CONFIG_DESIGNWARE_SPI=y
```
